#include <stdint.h>

#include "memory.h"

#ifdef TARGETWEB
#include "fake-progmen.h"
#include <emscripten/emscripten.h>
#else
#include <avr/pgmspace.h>
#endif

#include "MemIo/MemIo.h"
#include "MemIo/MemIoRam.h"
#include "MemIo/MemIoRom.h"
#include "MemIo/Riot002.h"

#include "roms/cassette.h"
#include "roms/monitor.h"
#include "roms/calcrom.h"
#include "roms/astroid.h"
#include "cpu.h"
#include "boardhardware.h"
#include "builtin_display.h"
#include "serial_display.h"
#include "kim-hardware.h"

/* MOVIT utility, copied into RAM 1780-17E3. Length: decimal 102 */
/* for use, see http://users.telenet.be/kim1-6502/6502/fbok.html#p114 */
const uint8_t movit[100] PROGMEM = {
    0xD8, 0xA0, 0xFF, 0x38, 0xA5, 0xD2, 0xE5, 0xD0,
    0x85, 0xD8, 0xA5, 0xD3, 0xE5, 0xD1, 0x85, 0xD9,
    0x18, 0xA5, 0xD8, 0x65, 0xD4, 0x85, 0xD6, 0xA5,
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    0xD0, 0x02, 0xC6, 0xD9, 0xD0, 0xCC, 0x00};

/* RELOCATE utility, copied into RAM 0110-01A4. Length: decimal 149 */
/* for use, see http://users.telenet.be/kim1-6502/6502/fbok.html#p114 */
const uint8_t relocate[149] PROGMEM = {
    0xD8, 0xA0, 0x00, 0xB1, 0xEA, 0xA8, 0xA2, 0x07,
    0x98, 0x3D, 0x8E, 0x01, 0x5D, 0x95, 0x01, 0xF0,
    0x03, 0xCA, 0xD0, 0xF4, 0xBC, 0x9D, 0x01, 0x30,
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    0x01, 0x01, 0x00, 0xFF, 0xFE};

/* BRANCH calculation utility, to be copied into RAM anywhere you want (relocatable). Length: decimal 42 */
/* for use, see http://users.telenet.be/kim1-6502/6502/fbok.htmln#p114 */
const uint8_t branch[42] PROGMEM = {
    0xD8, 0x18, 0xA5, 0xFA, 0xE5, 0xFB, 0x85, 0xF9, 0xC6, 0xF9, 0x20, 0x1F, 0x1F, 0x20, 0x6A, 0x1F,
    0xC5, 0xF3, 0xF0, 0xEC, 0x85, 0xF3, 0xC9, 0x10, 0xB0, 0xE6, 0x0A, 0x0A, 0x0A, 0x0A, 0xA2, 0x04,
    0x0A, 0x26, 0xFA, 0x26, 0xFB, 0xCA, 0xD0, 0xF8, 0xF0, 0xD6};


/* C:\temp27\KIM Uno\sw\tools\WozBaum disasm\WozBaum disasm\dis2.bin (02/09/2014 23:58:36)
   StartOffset: 00000000, EndOffset: 000001F8, Length: 000001F9 */
const uint8_t disasm[505] PROGMEM = {
    0x20, 0x0F, 0x20, 0x20, 0x9E, 0x1E, 0x20, 0x9E, 0x1E, 0x20, 0x9E, 0x1E,
    0x4C, 0x64, 0x1C, 0xA9, 0x0D, 0x85, 0x02, 0x20, 0x21, 0x20, 0x20, 0xFC,
    0x20, 0x85, 0x00, 0x84, 0x01, 0xC6, 0x02, 0xD0, 0xF2, 0x20, 0xE2, 0x20,
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    0x26, 0x72, 0x72, 0x88, 0xC8, 0xC4, 0xCA, 0x26, 0x48, 0x44, 0x44, 0xA2,
    0xC8};

const uint8_t mchess[1393] PROGMEM = {
    0xA9, 0x00, 0x85, 0xB7, 0x20, 0x54, 0xC4, 0xD8, 0xA2, 0xFF, 0x9A, 0xA2,
    0xC8, 0x86, 0xB2, 0x20, 0x78, 0xC3, 0x20, 0x49, 0xC4, 0xC9, 0x43, 0xD0,
    0x12, 0xA2, 0x1F, 0xBD, 0x14, 0xC5, 0x95, 0x50, 0xCA, 0x10, 0xF8, 0xA2,
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    0x52, 0x25, 0x0D, 0x45, 0x35, 0x04, 0x55, 0x22, 0x06, 0x43, 0x33, 0x0F,
    0xCC};

#ifdef USE_EPROM
extern uint8_t eepromread(uint16_t eepromaddress);
extern void eepromwrite(uint16_t eepromaddress, uint8_t bytevalue);
#endif

extern char threeHex[3][2]; // buffer for 3 hex digits
extern int blitzMode;       // status variable only for microchess

// --- OVERVIEW OF KIM-1 MEMORY MAP -------------------------------------------------
uint8_t RAM[ONBOARD_RAM]; // main 1KB RAM	     0x0000-0x04FF
// empty            					    0x0900-0x13FF
// I/O and timer of 6530-003, free for user  0x1700-0x173F, not used in KIM ROM
// I/O and timer of 6530-002, used by KIM    0x1740-0x177F, used by LED/Keyboard
uint8_t RAM003[64]; // RAM from 6530-003  0x1780-0x17BF, free for user applications
uint8_t RAM002[64]; // RAM from 6530-002  0x17C0-0x17FF, free for user except 0x17E7-0x17FF
// rom003 is                                 0x1800-0x1BFF
// rom002 is                                 0x1C00-0x1FFF

// note that above 8K map is not replicated 8 times to fill 64K,
// but INSTEAD, emulator mirrors last 6 bytes of ROM 002 to FFFB-FFFF:
//               FFFA, FFFB - NMI Vector
//               FFFC, FFFD - RST Vector
//               FFFE, FFFF - IRQ Vector
// Application roms (mchess) are above standard 8K of KIM-1

// --- ROM CODE SECTION ------------------------------------------------------------
// ROM1: KIM-1 ROM002 (monitor main code)                                 $17C0
// ROM2: KIM-1 ROM003 (tape and RS-232 code)                              $1780
// mchess: the updated microchess version from www.benlo.com/microchess
//                                                 recompiled to start at $C000
// calc: the 6502 floating point library from www.crbond.com/calc65.htm
//                                                 recompiled to start at $D000
// disassembler: the famous Baum & Wozniak disassember
//    6502.org/documents/publications/6502notes/6502_user_notes_14.pdf at $2000
// storage arrays that are copied to RAM are also here:
// relocate (first book of kim)                                        to $0110
// branch (first book of kim)                                          to $01A5
// movit (first book of kim)                                           to $1780
// ---------------------------------------------------------------------------------

MemIo *memio = new MemIo();
MemIoRom *rom1 = new MemIoRom();
MemIoRom *rom2 = new MemIoRom();
MemIoRiot002 *riotIo002 = new MemIoRiot002();
MemIoRam *ramMain = new MemIoRam();
MemIoRam *ramRiot002 = new MemIoRam();
MemIoRam *ramRiot003 = new MemIoRam();

// this is what user has to enter manually when powering KIM on. Why not do it here.
void initKIM()
{
    rom1->install(0x1800, 0x1BFF, cassette);
    rom2->install(0x1C00, 0x1FFF, monitor);
    ramMain->install(0x0000, ONBOARD_RAM, RAM);
    ramRiot003->install(0x1780, 0x17BF, RAM003);
    ramRiot002->install(0x17C0, 0x17FF, RAM002);

    uint16_t i;

    write6502(0x17FA, 0x00);
    write6502(0x17FB, 0x1C);
    write6502(0x17FE, 0x00);
    write6502(0x17FF, 0x1C);

    // the code below copies movit (a copy routine) to 0x1780 in RAM. It can be
    // overwritten by users - it's an extra note that the HTML version of the
    // book contains OR scan codes, so don't take the bytes from there!

    for (i = 0; i < 64; i++)
    { //64 of 102 program bytes
        //NOCOPY   RAM003[i] = pgm_read_byte_near(movit + i);
    }

    // movit spans into the second 64 byte memory segment...

    for (i = 0; i < (95 - 64); i++)
    {
        //NOCOPY  RAM002[i] = pgm_read_byte_near(movit + i + 64);
    }

    // the code below copies relocate to 0x0110 in RAM. It can be overwritten
    // by users or by the stack pointer - it's an extra

    for (i = 0; i < 149; i++)
    {
        //NOCOPY  RAM[i + 0x0110] = pgm_read_byte_near(relocate + i);
    }

    // the code below copies branch to 0x01A5 (not 0x17C0 anymore) in RAM. It
    // can be overwritten by users - it's an extra note: the program can easily
    // be damaged by the stack, because it ends at 1CF. Still, the monitor
    // brings the stack down to no worse than 0x1FF-8.

    for (i = 0; i < 42; i++)
    {
        //RAM002[i] = pgm_read_byte_near(branch + i);
        //NOCOPY  RAM[i + 0x01A5] = pgm_read_byte_near(branch + i);
    }
}

void loadTestProgram() // Call this from main() if you want a program preloaded. It's the first program from First Book of KIM...
{
    uint16_t i;

    // the first program from First Book of KIM...

    uint8_t fbkDemo[9] = {
        0xA5, 0x10, 0xA6, 0x11, 0x85, 0x11, 0x86, 0x10, 0x00};
    write6502(0x0010, 0x10);
    write6502(0x0011, 0x11);

    //uint8_t fbkDemo[13] = {
    //    0xa9, 0xff, 0x8d, 0x40, 0x17, 0xa9, 0x09, 0x8d, 0x42, 0x17, 0x4c, 0x0a, 0x02};

    // #define fbkDemo astroid
    size_t l = sizeof fbkDemo / sizeof fbkDemo[0];

    for (i = 0; i < l; i++)
    {
        write6502(i + 0x0200, fbkDemo[i]);
    }

    // load fltpt65 demo program
    uint8_t fltptDemo[31] = {
        0x20, 0xA1, 0x70, 0x20, 0xA2, 0x70, 0xA9, 0x02, 0x20, 0x00, 0x50, 0x20, 0xD3, 0x70,
        0x20, 0xAA, 0x70,
        0xF0, 0x08,
        0x20, 0x31, 0x70, 0xA9, 0x04, 0x20, 0x00, 0x50, 0x20, 0xD3, 0x70, 0x00};
    for (i = 0x0; i < 31; i++)
    {
        // NOCOPY RAM[i + 0x0210] = fltptDemo[i];
    }

    /* org=$0210
    JSR $6FF1
    JSR $6FF2

    LDA #$02
    JSR $5000
    JSR $6FE3
    JSR $6FC1
    LDA #$04

    JSR $5000

    JSR $6FE3
    BRK    */

    /*	uint8_t helloworld[0x28] = { // test program for Serial, prints hello world
    		0xAE, 0x13, 0x02, 0xCA, 0x8E, 0x13, 0x02, 0xBD,
    		0x14, 0x02, 0x20, 0xA0, 0x1E, 0xEC, 0x00, 0x00,
    		0xD0, 0xEE, 0x00, 0x13, 0x0D, 0x0A, 0x0D, 0x0A,
    		0x64, 0x6C,
    		0x72, 0x6F, 0x77, 0x20, 0x2C, 0x6F, 0x6C, 0x6C, 0x65, 0x48,
    		0x0D, 0x0A, 0x0D, 0x0A };

    	for (int iii=0x0200; iii<0x0224;iii++)
    		RAM[iii]=helloworld[iii-0x0200];
    */
}


uint8_t read6502(uint16_t address)
{
    uint8_t tempval = 0;

    if (ramMain->inRange(address))
    {
        return ramMain->read(address);
    }

#ifdef USE_EPROM
    if (address < 0x0800)
    {
        return (eepromread(address - 0x0400)); // 0x0400-0x0800 is EEPROM for Arduino,
    }                                          // 0x0800-0x1700 is empty space, should not be read
#endif

    if (riotIo002->inRange(address))
    {
        return riotIo002->read(address);
    }

    if (ramRiot003->inRange(address))
    {
        return ramRiot003->read(address);
    }

    if (ramRiot002->inRange(address))
    {
        return ramRiot002->read(address);
    }

    if (address < 0x2000)
    { // 0x1C00-0x2000 is ROM 002. It needs some intercepting from emulator...
        if (address == 0x1EA0)
        {                  // intercept OUTCH (send char to serial)
            serout(a);     // print A to serial
            pc = 0x1ED3;   // skip subroutine
            return (0xEA); // and return from subroutine with a fake NOP instruction
        }

        if (address == 0x1E65)
        {                  //intercept GETCH (get char from serial). used to be 0x1E5A, but intercept *within* routine just before get1 test
            a = getAkey(); // get A from main loop's curkey

            if (a == 0)
            {
                pc = 0x1E60; // cycle through GET1 loop for character start, let the 6502 runs through this loop in a fake way
                return (0xEA);
            }

            clearkey();
            x = read6502(0x00FD); // x is saved in TMPX by getch routine, we need to get it back in x;
            pc = 0x1E87;          // skip subroutine
            return (0xEA);        // and return from subroutine with a fake NOP instruction
        }

        if (address == 0x1C2A)
        {                                // intercept DETCPS
            RAM002[0x17F3 - 0x17C0] = 1; // just store some random bps delay on TTY in CNTH30
            RAM002[0x17F2 - 0x17C0] = 1; // just store some random bps delay on TTY in CNTL30
            pc = 0x1C4F;                 // skip subroutine
            return (0xEA);               // and return from subroutine with a fake NOP instruction
        }

        if (address == 0x1F1F)
        { // intercept SCANDS (display F9,FA,FB)
            // light LEDs ---------------------------------------------------------
            if (
                threeHex[0][0] != (read6502(0x00FB) & 0xF0) >> 4 ||
                threeHex[0][1] != (read6502(0x00FB) & 0xF) ||
                threeHex[1][0] != (read6502(0x00FA) & 0xF0) >> 4 ||
                threeHex[1][1] != (read6502(0x00FA) & 0xF) ||
                threeHex[2][0] != (read6502(0x00F9) & 0xF0) >> 4 ||
                threeHex[2][1] != (read6502(0x00F9) & 0xF))
            {

                threeHex[0][0] = (read6502(0x00FB) & 0xF0) >> 4;
                threeHex[0][1] = read6502(0x00FB) & 0xF;
                threeHex[1][0] = (read6502(0x00FA) & 0xF0) >> 4;
                threeHex[1][1] = read6502(0x00FA) & 0xF;
                threeHex[2][0] = (read6502(0x00F9) & 0xF0) >> 4;
                threeHex[2][1] = read6502(0x00F9) & 0xF;
            }
            serial_scands();
            // driveLEDs();

            //pc = 0x1F45;   // skip subroutine part that deals with LEDs
            //return (0xEA); // and return a fake NOP instruction for this first read in the subroutine, it'll now go to AK
        }

#ifdef EMULATE_KEYBOARD
        if (address == 0x1EFE)
        {                  // intercept AK (check for any key pressed)
            a = getAkey(); // 0 means no key pressed - the important bit - but if a key is pressed is curkey the right value to send back?
            //a= getKIMkey();
            if (a == 0)
                a = 0xFF; // that's how AK wants to see 'no key'
            pc = 0x1F14;  // skip subroutine

            return (0xEA); // and return a fake NOP instruction for this first read in the subroutine, it'll now RTS at its end
        }
#endif

#ifdef EMULATE_KEYBOARD
        if (address == 0x1F6A)
        { // intercept GETKEY (get key from keyboard)
            //		serout('-');serout('G');serout('K');serout('-');
            a = getKIMkey(); // curkey = the key code in the emulator's keyboard buffer
            clearkey();
            pc = 0x1F90;   // skip subroutine part that deals with LEDs
            return (0xEA); // and return a fake NOP instruction for this first read in the subroutine, it'll now RTS at its end
        }
#endif
    }

    if (rom1->inRange(address))
    {
        return rom1->read(address);
    }

    if (rom2->inRange(address))
    {
        return rom2->read(address);
    }

    if (address < 0x21F9)
    { // 0x2000-0x21F8 is disasm
        return (pgm_read_byte_near(disasm + address - 0x2000));
    }

    if (address == 0x6666)
    {
        uint16_t p1 = 0x5000;
        uint16_t p2 = (sizeof calcRom / sizeof calcRom[0]) + p1;

        uint16_t offset = *calcRom + address - 0x5000;

        // printf("%04x %04x %04x %04x\n", offset, address, p1, p2);
    }

    if ((address >= 0x5000) && (address <= (sizeof calcRom / sizeof calcRom[0]) + 0x5000))
    {
        // 0x6FDF, plus 4 bytes for JSR manually added -
        // Read to floating point library between $5000 and $6157

        return (pgm_read_byte_near(calcRom + address - 0x5000));
    }

    if (address >= 0xC000 && address <= 0xC571)
    {                           // Read to Microchess ROM between $C000 and $C571
        if (address == 0xC202)  // intercept C202: Blitz mode should return 0 instead of 8
            if (blitzMode == 1) // This is the Blitz mode hack from the microchess manual.
                return ((uint8_t)0x00);

        return (pgm_read_byte_near(mchess + address - 0xC000)); // mchess ROM
    }

    // I/O functions just for Microchess: ---------------------------------------------------
    // $F003: 0 = no key pressed, 1 key pressed
    // $F004: input from user
    // (also, in write6502: $F001: output character to display)
    if (address == 0xCFF4)
    { //simulated keyboard input
        tempval = getAkey();
        clearkey();
        // translate KIM-1 button codes into ASCII code expected by this version of Microchess
        switch (tempval)
        {
        case 16:
            tempval = 'P';
            break; // PC translated to P
        case 'F':
            tempval = 13;
            break; // F translated to Return
        case '+':
            tempval = 'W';
            break; // + translated to W meaning Blitz mode toggle
        }
        if (tempval == 0x57)
        { // 'W'. If user presses 'W', he wants to enable Blitz mode.
            if (blitzMode == 1)
                (blitzMode = 0);
            else
                (blitzMode = 1);
            serout('>');
            serout((blitzMode == 1) ? 'B' : 'N');
            serout('<');
        }
        clear_display();
        return (tempval);
    }
    if (address == 0xCFF3)
    {
        // simulated keyboard input 0=no key press, 1 = key press light LEDs

        threeHex[0][0] = (read6502(0x00FB) & 0xF0) >> 4;
        threeHex[0][1] = read6502(0x00FB) & 0xF;
        threeHex[1][0] = (read6502(0x00FA) & 0xF0) >> 4;
        threeHex[1][1] = read6502(0x00FA) & 0xF;
        threeHex[2][0] = (read6502(0x00F9) & 0xF0) >> 4;
        threeHex[2][1] = read6502(0x00F9) & 0xF;
        driveLEDs();

        return (getAkey() == 0 ? (uint8_t)0 : (uint8_t)1);
    }

    if (address >= 0xFFFA)
    {
        // 6502 reset and interrupt vectors. Reroute to top of ROM002.
        return (pgm_read_byte_near(monitor + address - 0xFC00));
    }

    return (0xE1);
}

void write6502(uint16_t address, uint8_t value)
{
    if (ramMain->inRange(address))
    {
        ramMain->write(address, value);
    }

#ifdef USE_EPROM
    if (address < 0x0800)
    {
        eepromwrite(address - 0x0400, value); // 0x0500-0x0900 is EEPROM for Arduino,
        return;
    }
#endif

    if (address < 0x1700)
    { // illegal access
        serout('%');
        serout('1'); // error code 1 - write in empty space
        return;
    }
    if (address < 0x1740)
    { // I/O 003
        serout('%');
        serout('3'); // trap code 3 - io3 access
        return;
    }

    if (riotIo002->inRange(address))
    {
        riotIo002->write(address, value);
    }

    if (ramRiot003->inRange(address))
    {
        ramRiot003->write(address, value);
    }

    if (ramRiot002->inRange(address))
    {
        ramRiot002->write(address, value);
    }

    if ((address >= 0x5000) && (address <= 0x6FDF))
    { // illegal write in fltpt65 ROM
        //	  printf("WARNING: WRITE TO ROM\n");
        serout('%');
        serout('a');
        return;
    }

    // Character out function for microchess only: write to display at $F001
    if (address == 0xCFF1)
    { // Character out for microchess only
        serout(value);
        return;
    }
    serout('%');
    serout('4'); // error code 4 - write to ROM
}
